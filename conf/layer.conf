## conf/layer.conf
```bitbake
# We have a conf and classes directory, add to BBPATH
BBPATH .= ":${LAYERDIR}"

# We have recipes-* directories, add to BBFILES
BBFILES += "${LAYERDIR}/recipes-*/*/*.bb \
	${LAYERDIR}/recipes-*/*/*.bbappend"

BBFILE_COLLECTIONS += "meta-eb-solys"
BBFILE_PATTERN_meta-eb-solys = "^${LAYERDIR}/"
BBFILE_PRIORITY_meta-eb-solys = "15"
```
